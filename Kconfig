## Kconfig
```kconfig
# SPDX-License-Identifier: GPL-3.0-or-later

mainmenu "MOS Kernel Configuration"

source "kernel/Kconfig"

source "libs/Kconfig"

source "userspace/Kconfig"
```

## arch/Kconfig
```kconfig
# SPDX-License-Identifier: GPL-3.0-or-later

menu "Architecture options"

config ADDR_USER_HEAP
    hex "User heap address"
    default 0x0100000000

config ADDR_USER_STACK
    hex "User stack address"
    default 0x5000000000

config ADDR_USER_MMAP
    hex "User mmap address"
    default 0x1000000000

config PLATFORM_DEBUG_ALL
    bool "Enable all platform-specific debug options"
    select PLATFORM_DEBUG_ALL_x86_64
    select PLATFORM_DEBUG_ALL_riscv64
    select GENERIC_PLATFORM_DEBUG_ALL
    help
    Enable all platform-specific debug options

source "arch/generic/Kconfig"

source "arch/$ARCH/Kconfig"

endmenu
```

## arch/generic/Kconfig
```kconfig
# SPDX-License-Identifier: GPL-3.0-or-later

config GENERIC_PLATFORM_DEBUG_ALL
    bool
    select DEBUG_limine

config DEBUG_limine
    bool "limine startup debug"
```

## arch/riscv64/Kconfig
```kconfig
menu "riscv64 configuration"

config PAGE_SIZE
    int "Page size"
    default 4096

endmenu
```

## arch/x86_64/Kconfig
```kconfig
# SPDX-License-Identifier: GPL-3.0-or-later

menu "x86-64 configuration"

config PAGE_SIZE
    int "Page size"
    default 4096

config HWMEM_VADDR
    hex "Hardware memory virtual address"
    default 0xFFFFFFFFA0000000

menu "x86-64 debugging options"

config PLATFORM_DEBUG_ALL_x86_64
    bool
    help
        Enable all x86-64 debugging options, this is rarely needed.
    select DEBUG_x86_cpu
    select DEBUG_x86_lapic
    select DEBUG_x86_ioapic
    select DEBUG_x86_startup
    select DEBUG_x86_acpi

config DEBUG_x86_cpu
    bool "x86 CPU debug"

config DEBUG_x86_lapic
    bool "x86 LAPIC debug"

config DEBUG_x86_ioapic
    bool "x86 IOAPIC debug"

config DEBUG_x86_startup
    bool "x86 startup debug"

config DEBUG_x86_acpi
    bool "x86 ACPI debug"

endmenu
endmenu
```

## kernel/Kconfig
```kconfig
# SPDX-License-Identifier: GPL-3.0-or-later

source "kernel/arch/Kconfig"

# ! ============================================================
config DEFAULT_INIT_PATH
    string "Default init program path"
    default "/initrd/programs/bootstrapper"
    help
    This is the default path to the init program that the kernel will
    execute if no init=/program is specified in the command line.

config EXTRA_CMDLINE
    string "Extra command line arguments"
    default ""
    help
    This option allows you to specify extra command line arguments
    that will be passed to the kernel at boot time.

config SMP
    bool "SMP support"
    default n

config MM_DETAILED_UNHANDLED_FAULT
    bool "Print detailed information on unhandled #PF"
    default y

config MM_DETAILED_MMAPS_UNHANDLED_FAULT
    bool "Print process mmap information on unhandled #PF"
    default n

config DYNAMIC_DEBUG
    bool "Runtime kernel debugging switches"
    default y
    help
    This option adds support for dynamic debug messages. This allows
    you to enable and disable debug messages at runtime.

config INODE_CACHE_HASHMAP_SIZE
    int "Inode cache hashmap size"
    default 256

config ELF_INTERPRETER_BASE_OFFSET
    hex "ELF interpreter base offset"
    default 0x100000

config INITRD_BASE
    hex "Address of the initrd when mapped in init process"
    default 0x300000000

# ! ============================================================
menu "Kernel Limits"

config MAX_CPU_COUNT
    int "Maximum number of CPUs"
    default 8
    help
    This is the maximum number of CPUs that the kernel will support.

    In MOS, the `per_cpu` macro uses an array to store per-CPU data.
    This option sets the size of the array.

config MAX_CMDLINE_COUNT
    int "Maximum number of command line arguments"
    default 64

config MAX_MEMREGIONS
    int "Maximum number of bootloader-provided memory regions"
    default 64

config PROCESS_MAX_OPEN_FILES
    int "Maximum number of open files per process"
    default 64
    help
    This is the maximum number of files that a process can have open at
    once. The larger this number is, the larger `process_t` will be.
    Please consider this tradeoff when setting the value.

config PATH_MAX_LENGTH
    int "Maximum length of paths"
    default 256

config STACK_PAGES_KERNEL
    int "Number of pages for kernel stack"
    default 8

config STACK_PAGES_USER
    int "Number of pages for user stack"
    default 32

endmenu

# ! ============================================================
menu "Miscellaneous Kernel Options"

config UBSAN
    bool "enable undefined behavior sanitizer"
    default n

config PROFILING
    bool "enable TSC-based kernel profiling"
    default n

endmenu

# ! ============================================================
menu "Kernel Logging"
source "kernel/syslog/Kconfig"
endmenu

# ! ============================================================
menu "Kernel Debugging Log Options"
source "kernel/Kconfig.debug"
endmenu

# ! ============================================================
config TESTS
    bool "Kernel-space unit tests"
    default y

if TESTS

menu "Select tests to build"
source "kernel/tests/Kconfig"
endmenu

endif
```

## kernel/Kconfig.debug
```kconfig
# SPDX-License-Identifier: GPL-3.0-or-later

config DEBUG_ALL
    bool "Enable all platform-independent debugging logs"
    select DEBUG_acpi
    select DEBUG_apic
    select DEBUG_cpio
    select DEBUG_dcache
    select DEBUG_dcache_ref
    select DEBUG_dma
    select DEBUG_elf
    select DEBUG_futex
    select DEBUG_io
    select DEBUG_ipc
    select DEBUG_ipi
    select DEBUG_panic
    select DEBUG_pagefault
    select DEBUG_pipe
    select DEBUG_pmm
    select DEBUG_pmm_buddy
    select DEBUG_process
    select DEBUG_scheduler
    select DEBUG_setup
    select DEBUG_signal
    select DEBUG_slab
    select DEBUG_spinlock
    select DEBUG_syscall
    select DEBUG_sysfs
    select DEBUG_thread
    select DEBUG_tmpfs
    select DEBUG_userfs
    select DEBUG_vfs
    select DEBUG_vmm

config DEBUG_cpio
    bool "Initrd cpio archive debugging log"

config DEBUG_dcache
    bool "Directory entry cache debugging"

config DEBUG_dcache_ref
    bool "Directory entry cache referencing debugging"

config DEBUG_dma
    bool "DMA allocator debugging"

config DEBUG_elf
    bool "ELF program loader debugging log"

config DEBUG_futex
    bool "Futex debugging"

config DEBUG_io
    bool "IO interface debugging log"

config DEBUG_ipc
    bool "IPC connection debugging"

config DEBUG_ipi
    bool "Inter-processor interrupt debugging"

config DEBUG_panic
    bool "Kernel panic debugging"

config DEBUG_pagefault
    bool "Page fault debugging log"

config DEBUG_pipe
    bool "Pipe debugging"

config DEBUG_pmm
    bool "Physical memory manager debugging log"

config DEBUG_pmm_buddy
    bool "Buddy-allocator debugging log"
    select DEBUG_pmm

config DEBUG_process
    bool "Process creation, termination and wait debugging log"

config DEBUG_scheduler
    bool "Scheduler debugging log"

config DEBUG_setup
    bool "Kernel setup debugging log"

config DEBUG_signal
    bool "Signal debugging"

config DEBUG_slab
    bool "Slab allocator debugging"

config DEBUG_spinlock
    bool "Spinlock debugging"

config DEBUG_syscall
    bool "System call tracing"

config DEBUG_sysfs
    bool "SysFS debugging"

config DEBUG_thread
    bool "Thread creation and destruction debugging log"

config DEBUG_tmpfs
    bool "TmpFS debugging"

config DEBUG_userfs
    bool "UserFS debugging"

config DEBUG_vfs
    bool "VFS debugging"

config DEBUG_vmm
    bool "Virtual memory manager debugging log"
```

## kernel/arch/Kconfig
```kconfig
# SPDX-License-Identifier: GPL-3.0-or-later

source "kernel/arch/generic/Kconfig"

menu "Architecture ($ARCH) Configuration"

source "kernel/arch/$ARCH/Kconfig"

endmenu
```

## kernel/arch/generic/Kconfig
```kconfig
# SPDX-License-Identifier: GPL-3.0-or-later

menu "Generic architecture options"

config ADDR_USER_STACK
    hex "User stack address"
    default 0x5000000000

config ADDR_USER_MMAP
    hex "User mmap address"
    default 0x1000000000

config PLATFORM_DEBUG_ALL
    bool "Enable all platform-specific debug options"
    select PLATFORM_DEBUG_ALL_x86_64
    select PLATFORM_DEBUG_ALL_riscv64
    select GENERIC_PLATFORM_DEBUG_ALL
    help
    Enable all platform-specific debug options

config GENERIC_PLATFORM_DEBUG_ALL
    bool
    select DEBUG_limine

config DEBUG_limine
    bool "limine startup debug"

endmenu
```

## kernel/arch/riscv64/Kconfig
```kconfig
# SPDX-License-Identifier: GPL-3.0-or-later

config PAGE_SIZE
    int "Page size"
    default 4096

config PLATFORM_DEBUG_ALL_riscv64
    bool
    select DEBUG_riscv64_startup

config DEBUG_riscv64_startup
    bool "RISC-V startup debug"
```

## kernel/syslog/Kconfig
```kconfig
# SPDX-License-Identifier: GPL-3.0-or-later

config PRINTK_HAS_SOME_PREFIX
    bool
    help
    If this option is selected, the kernel enable special handling
    for kernel messages.

    For a list of options that will select this option, read the
    Kconfig files in `kernel/`.

config PRINTK_WITH_TIMESTAMP
    bool "Include timestamp in debug messages"
    default n
    select PRINTK_HAS_SOME_PREFIX

config PRINTK_WITH_DATETIME
    bool "Include date and time in debug messages"
    default n
    select PRINTK_HAS_SOME_PREFIX

config PRINTK_WITH_CPU_ID
    bool "Include CPU ID in debug messages"
    default n
    select PRINTK_HAS_SOME_PREFIX

config PRINTK_WITH_FILENAME
    bool "Include filename in debug messages"
    default n
    select PRINTK_HAS_SOME_PREFIX

config PRINTK_WITH_THREAD_ID
    bool "Include Thread ID in debug messages"
    default n
    select PRINTK_HAS_SOME_PREFIX
```

## kernel/tests/Kconfig
```kconfig
# SPDX-License-Identifier: GPL-3.0-or-later

config TEST_ALL
    bool "Build all tests"
    default y
    select TEST_printf
    select TEST_linked_list
    select TEST_kmalloc
    select TEST_cmdline_parser
    select TEST_hashmap
    select TEST_downwards_stack
    select TEST_memops
    select TEST_ring_buffer
    select TEST_vfs

config TEST_printf
    bool "Test printf"

config TEST_linked_list
    bool "Test linked list"

config TEST_kmalloc
    bool "Test kmalloc"

config TEST_cmdline_parser
    bool "Test cmdline parser"

config TEST_hashmap
    bool "Test hashmap"

config TEST_downwards_stack
    bool "Test downwards stack"

config TEST_memops
    bool "Test memory-related operations"

config TEST_ring_buffer
    bool "Test ring buffer"

config TEST_vfs
    bool "Test VFS operations"
```

## libs/Kconfig
```kconfig
# SPDX-License-Identifier: GPL-3.0-or-later

menu "Library Options"

config MLIBC_HEADER_DIR
    string "mlibc header include directory"
    default "/opt/$ARCH-mos/include/"
    help
      The directory where the C library 'mlibc' headers are installed.

endmenu
```

## tests/Kconfig
```kconfig
# SPDX-License-Identifier: GPL-3.0-or-later

config TESTS
    bool "Kernel-space unit tests"
    default n

if TESTS

menu "Select tests to build"

config TEST_printf
    bool "Test printf"
    default y

config TEST_linked_list
    bool "Test linked list"
    default y

config TEST_kmalloc
    bool "Test kmalloc"
    default y

config TEST_cmdline_parser
    bool "Test cmdline parser"
    default y

config TEST_hashmap
    bool "Test hashmap"
    default y

config TEST_downwards_stack
    bool "Test downwards stack"
    default y

config TEST_memops
    bool "Test memory-related operations"
    default y

config TEST_ring_buffer
    bool "Test ring buffer"
    default y

config TEST_vfs
    bool "Test VFS operations"
    default y


endmenu

endif
```

## userspace/Kconfig
```kconfig
# SPDX-License-Identifier: GPL-3.0-or-later

menu "Userspace options"

config RUST_TARGET
    string "Userspace Rust target"
    default "$ARCH-unknown-mos"

endmenu
```
